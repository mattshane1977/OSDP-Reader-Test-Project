## main/Kconfig.projbuild
```kconfig
menu "OSDP LEAF reader"

choice NFC_DRIVER
    prompt "NFC front-end driver"
    default NFC_DRIVER_PN532
    help
        Selects which RFID chip's driver gets compiled in. The DESFire and
        LEAF layers don't care which one is used — they call through the
        nfc_hal interface.

config NFC_DRIVER_PN532
    bool "PN532 (SPI) — original bring-up hardware"

config NFC_DRIVER_PN5180
    bool "PN5180 (SPI) — preferred for DESFire EV3"

endchoice

endmenu
```

## sdkconfig.defaults
```kconfig
# Target chip
CONFIG_IDF_TARGET="esp32s3"

# Dual-core scheduling — OSDP on core 0, NFC on core 1
CONFIG_FREERTOS_UNICORE=n

# mbedTLS — enable hardware AES + CMAC (used by both DESFire and OSDP-SC)
CONFIG_MBEDTLS_HARDWARE_AES=y
CONFIG_MBEDTLS_CMAC_C=y

# NVS encryption — site keys live here, not in firmware blob
CONFIG_NVS_ENCRYPTION=n
# CONFIG_FLASH_ENCRYPTION_ENABLED is not set

# Stack + log
CONFIG_ESP_MAIN_TASK_STACK_SIZE=6144
CONFIG_LOG_DEFAULT_LEVEL_INFO=y

# Watchdog generous enough for crypto-heavy paths
CONFIG_ESP_TASK_WDT_TIMEOUT_S=10

# Partition Table
CONFIG_PARTITION_TABLE_CUSTOM=y
CONFIG_PARTITION_TABLE_CUSTOM_FILENAME="partitions.csv"
CONFIG_PARTITION_TABLE_FILENAME="partitions.csv"
CONFIG_PARTITION_TABLE_OFFSET=0x10000

# WebUI — WebSocket support required for live event stream
CONFIG_HTTPD_WS_SUPPORT=y

# NFC driver
CONFIG_NFC_DRIVER_PN5180=y
# CONFIG_NFC_DRIVER_PN532 is not set
```
